## config/west.yml
```yaml
manifest:
  remotes:
    - name: zmkfirmware
      url-base: https://github.com/zmkfirmware
    - name: michaeltyson
      url-base: https://github.com/michaeltyson
  projects:
    - name: zmk
      remote: michaeltyson
      revision: main
      import: app/west.yml
  self:
    path: config
```
